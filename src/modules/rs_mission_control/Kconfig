## src/modules/rs_mission_control/Kconfig
```kconfig
menuconfig MODULES_RS_MISSION_CONTROL
    bool "Robosub Mission Control"
    default n
    ---help---
        Custom mission and movement control module for Robosub
```

## src/modules/rs_mission_coordinator/Kconfig
```kconfig
menuconfig MODULES_RS_MISSION_COORDINATOR
    bool "Robosub Mission Coordinator"
    default n
    ---help---
        Coordinates mission selection and mode handling for Robosub
```
